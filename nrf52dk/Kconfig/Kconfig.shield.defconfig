## nrf52dk/sta/Kconfig/boards/Kconfig.defconfig
```kconfig
# Load Zephyr board defconfig descriptions.
osource "C:/nrf/v3.1.0/zephyr/boards/nordic/nrf52840dk/Kconfig.defconfig"
```

## nrf52dk/sta/Kconfig/boards/Kconfig.nrf52840dk
```kconfig
# Load board Kconfig descriptions.
osource "C:/nrf/v3.1.0/zephyr/boards/nordic/nrf52840dk/Kconfig.nrf52840dk"
```
